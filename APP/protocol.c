#include "protocol.h"
#include "usart.h"
#include "pstwo.h"

uint16_t pitch,roll,yaw;
uint16_t depth;
uint8_t battery;

u8 CRC_Make[6];
u8 CRC_High,CRC_Low;
u16 CRC_Result;
unsigned int crc_ta[256] = {               /* CRC??? */
	0x0000, 0x1021, 0x2042, 0x3063, 0x4084, 0x50a5, 0x60c6, 0x70e7,
	0x8108, 0x9129, 0xa14a, 0xb16b, 0xc18c, 0xd1ad, 0xe1ce, 0xf1ef,
	0x1231, 0x0210, 0x3273, 0x2252, 0x52b5, 0x4294, 0x72f7, 0x62d6,
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	0x6e17, 0x7e36, 0x4e55, 0x5e74, 0x2e93, 0x3eb2, 0x0ed1, 0x1ef0
};


u16 do_crc(u8 *ptr, int len)
{
	u16 crc;
	u16  da;
	crc = 0;
	while (len-- != 0)
	{
		da = (unsigned short)crc >> 8;   /* ?8??????????CRC??8? */
		crc <<= 8;              /* ??8?,???CRC??8???  */
		crc ^= crc_ta[da^*ptr];   /* ?8?????????????CRC ,??????CRC */
		ptr++;
	}
	return(crc);
};

//uint8_t Send_flag；





/******************************************************************************
函数原型：	void Status_Get(void) 
功    能：	得到ROV状态
参    数：  无
*******************************************************************************/ 
void Status_Get(void)  
{
	if(state_machine == 3)//检验数据是否保存完毕
	{ 
		state_machine=0;
		
		pitch = (200*Rx_Buffer[1]+Rx_Buffer[2]);
		roll = (200*Rx_Buffer[3]+Rx_Buffer[4]);
		yaw = (200*Rx_Buffer[5]+Rx_Buffer[6]);
		
		depth = (200*Rx_Buffer[7]+Rx_Buffer[8]);
		
		battery = Rx_Buffer[9];
		
	
	}


}

/******************************************************************************
函数原型：	void Send_Command(void) 
功    能：	发送ROV控制命令
参    数：  无
*******************************************************************************/ 
void Send_Command(void) 
{
	u8 t;
	int i;
	delay_ms(40);	 
	
	Tx_Buffer[0]=0x58;
			
			Tx_Buffer[1]=PS2_AnologData(PSS_LX);//获取摇杆
			Tx_Buffer[2]=PS2_AnologData(PSS_LY);
			Tx_Buffer[3]=PS2_AnologData(PSS_RX);
			Tx_Buffer[4]=PS2_AnologData(PSS_RY);
			
			Tx_Buffer[5]=PS2_DataKey();//获取键值
			
					
			for(i=0;i<5;i++)
			{
					CRC_Make[i]=Tx_Buffer[i+1];
			}
					
			CRC_Result=do_crc(CRC_Make, 5);
			CRC_High=CRC_Result>>8;
			CRC_Low=CRC_Result&0xff;
			
			Tx_Buffer[6]=CRC_High;//crc校验位
			Tx_Buffer[7]=CRC_Low;
			
			Tx_Buffer[8]=0x59;//数据压入
					
						for(t=0;t<9;t++)//数据发出
						{
				USART_SendData(USART1, Tx_Buffer[t]);//向串口1发送数据
				while(USART_GetFlagStatus(USART1,USART_FLAG_TC)!=SET);//等待发送结束
						}
			
}
	


































